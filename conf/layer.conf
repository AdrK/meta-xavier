## conf/layer.conf
```bitbake
# We have a conf and classes directory, add to BBPATH
BBPATH .= ":${LAYERDIR}"

# We have recipes-* directories, add to BBFILES
BBFILES += "${LAYERDIR}/recipes-*/*/*.bb \
	    ${LAYERDIR}/recipes-*/*/*/*.bb \
            ${LAYERDIR}/recipes-*/*/*.bbappend \
            ${LAYERDIR}/recipes-*/*/*/*.bbappend"

BBFILE_COLLECTIONS += "meta-xavier"
BBFILE_PATTERN_meta-xavier = "^${LAYERDIR}/"
BBFILE_PRIORITY_meta-xavier = "6"

LAYERDEPENDS_meta-xavier = "core"
LAYERSERIES_COMPAT_meta-xavier = "thud"
```
